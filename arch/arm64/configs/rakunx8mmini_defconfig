## arch/arm64/configs/rakunx8mmini_defconfig
```kconfig
CONFIG_TOUCHSCREEN_EDT_FT5X06=y
CONFIG_DRM_PANEL_RASPBERRYPI_TOUCHSCREEN=y
CONFIG_MWIFIEX=m
CONFIG_MWIFIEX_SDIO=m
CONFIG_BT_MRVL=m
CONFIG_BT_MRVL_SDIO=m
CONFIG_MXC_CAMERA_OV5647_MIPI=y
CONFIG_VIDEO_IMX219=y
```
